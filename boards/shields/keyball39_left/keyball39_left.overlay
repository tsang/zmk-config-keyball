// zmk/app/boards/shields/keyball39_left/keyball39_left.overlay
&keyball39_left {
    compatible = "zmk,keyboard";
    label = "Keyball39 Left";

    key-matrix {
        compatible = "zmk,matrix-transform";
        rows = <5>;
        columns = <5>;

        row-gpios = <&gpio0 0 GPIO_ACTIVE_LOW>,
                    <&gpio0 1 GPIO_ACTIVE_LOW>,
                    <&gpio0 2 GPIO_ACTIVE_LOW>,
                    <&gpio0 3 GPIO_ACTIVE_LOW>,
                    <&gpio0 4 GPIO_ACTIVE_LOW>;

        col-gpios = <&gpio1 0 GPIO_ACTIVE_LOW>,
                    <&gpio1 1 GPIO_ACTIVE_LOW>,
                    <&gpio1 2 GPIO_ACTIVE_LOW>,
                    <&gpio1 3 GPIO_ACTIVE_LOW>,
                    <&gpio1 4 GPIO_ACTIVE_LOW>;
    };

    ec11: ec11@0 {
        compatible = "zmk,ec11";
        label = "EC11 Rotary Encoder";
        gpios = <&gpio0 6 GPIO_ACTIVE_LOW>,
                <&gpio0 7 GPIO_ACTIVE_LOW>;
        resolution = <2>;
    };
};
