## boards/shields/keyball39/Kconfig.defconfig
```kconfig
if SHIELD_KEYBALL39_LEFT

    config ZMK_KEYBOARD_NAME
        default "Keyball39 (left)"

    config ZMK_SPLIT_ROLE_CENTRAL
        default y 

endif

if SHIELD_KEYBALL39_RIGHT

    config ZMK_KEYBOARD_NAME
        default "Keyball39 (right)"

endif

if SHIELD_KEYBALL39_LEFT || SHIELD_KEYBALL39_RIGHT

    config ZMK_SPLIT
        default y

endif
```

## boards/shields/keyball39_left/Kconfig
```kconfig
// zmk/app/boards/shields/keyball39_left/Kconfig
config SHIELD_KEYBALL39_LEFT
    bool "Keyball39 Left Shield"
    select BOARD_NICE_NANO_V2
    select ZMK_ENCODER  // Ensure encoder support is selected
    help
        Enable support for the Keyball39 Left keyboard half.
```

## boards/shields/keyball39_right/Kconfig
```kconfig
// zmk/app/boards/shields/keyball39_right/Kconfig
config SHIELD_KEYBALL39_RIGHT
    bool "Keyball39 Right Shield"
    select BOARD_NICE_NANO_V2
    select PWM3360  // Ensure PWM3360 support is selected
    help
        Enable support for the Keyball39 Right keyboard half.
```

## config/boards/shields/keyball39/Kconfig.defconfig
```kconfig
if SHIELD_KEYBALL39_LEFT

    config ZMK_KEYBOARD_NAME
        default "Kball39-Slv"

endif

if SHIELD_KEYBALL39_RIGHT

    config ZMK_KEYBOARD_NAME
        default "Kball39-Mtr"

    config ZMK_SPLIT_ROLE_CENTRAL
        default y 

endif

if SHIELD_KEYBALL39_LEFT || SHIELD_KEYBALL39_RIGHT

    config ZMK_SPLIT
        default y

endif
```

## config/west.yml
```yaml
manifest:
  remotes:
    - name: zmkfirmware
      url-base: https://github.com/petejohanson
    - name: zmk-pmw3610-driver
       url-base: https://github.com/tsang
  projects:
    - name: zmk
      remote: zmkfirmware
      revision: feat/pointers-move-scroll
      import: app/west.yml
    - name: zmk-pmw3610-driver
      remote: tsang
      revision: pmw3360
  self:
    path: config
```
